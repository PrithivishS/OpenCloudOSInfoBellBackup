## drivers/crypto/hisilicon/Kconfig
```kconfig
source "drivers/crypto/hisilicon/hisilicon/Kconfig"
source "drivers/crypto/hisilicon/uacce/Kconfig"
```

## drivers/i3c/master/Kconfig
```kconfig
# SPDX-License-Identifier: GPL-2.0-only
config CDNS_I3C_MASTER
	tristate "Cadence I3C master driver"
	depends on I3C
	depends on HAS_IOMEM
	depends on !(ALPHA || PARISC)
	help
	  Enable this driver if you want to support Cadence I3C master block.

config PHYTIUM_I3C_MASTER
	tristate "Phytium I3C master driver"
	depends on I3C
	depends on HAS_IOMEM
	depends on !(ALPHA || PARISC)
	help
	  Enable this driver if you want to support Phytium I3C master block.
	  
	  This driver is defaultly disabled on OpenCloudOS 8.8. If your
	  device is using e2000 as BMC of d2000 or s2500, please manually
	  enable this module.

config DW_I3C_MASTER
	tristate "Synospsys DesignWare I3C master driver"
	depends on I3C
	depends on HAS_IOMEM
	depends on !(ALPHA || PARISC)
	# ALPHA and PARISC needs {read,write}sl()
	help
	  Support for Synopsys DesignWare MIPI I3C Controller.

	  For details please see
	  https://www.synopsys.com/dw/ipdir.php?ds=mipi_i3c

	  This driver can also be built as a module.  If so, the module
	  will be called dw-i3c-master.
```

## kernel/tkernel/Kconfig
```kconfig
# SPDX-License-Identifier: GPL-2.0-only

source "kernel/tkernel/irqlatency/Kconfig"
source "kernel/tkernel/kpatch/Kconfig"
```

## kernel/tkernel/irqlatency/Kconfig
```kconfig
# SPDX-License-Identifier: GPL-2.0-only
config IRQ_LATENCY
	tristate "irq latency debug"
	depends on STACKTRACE
	depends on X86
	default y
	help
	  This option adds support for irq latency debug.
```
